VERSION ""

NS_ :

BS_:

BU_:

BO_ 2365523200 test_short: 2 Vector__XXX
 SG_ zero : 0|8@1+ (0,0) [0|255] "unit" Vector__XXX
 SG_ one : 8|8@1+ (0,0) [0|255] "unit" Vector__XXX

BO_ 2365522944 test_long: 9 Vector__XXX
 SG_ zero : 0|8@1+ (0,0) [0|255] "unit" Vector__XXX
 SG_ one : 8|8@1+ (0,0) [0|255] "unit" Vector__XXX
 SG_ two : 16|8@1+ (0,0) [0|255] "unit" Vector__XXX
 SG_ three : 24|8@1+ (0,0) [0|255] "unit" Vector__XXX
 SG_ four : 32|8@1+ (0,0) [0|255] "unit" Vector__XXX
 SG_ five : 40|8@1+ (0,0) [0|255] "unit" Vector__XXX
 SG_ six : 48|8@1+ (0,0) [0|255] "unit" Vector__XXX
 SG_ seven : 56|8@1+ (0,0) [0|255] "unit" Vector__XXX
 SG_ eight : 64|8@1+ (0,0) [0|255] "unit" Vector__XXX

BO_ 2364540158 EEC1: 8 Vector__XXX
 SG_ EngineSpeed : 24|16@1+ (0.125,0) [0|8031.875] "rpm" Vector__XXX

BO_ 2566844926 CCVS1: 8 Vector__XXX
 SG_ WheelBasedVehicleSpeed : 8|16@1+ (0.00390625,0) [0|250.996] "km/h" Vector__XXX

BO_ 2566845438 VP1: 8 Vector__XXX
 SG_ Latitude : 0|32@1+ (0.0000001,-210) [-210|211.1081215] "deg" Vector__XXX
 SG_ Longitude : 32|32@1+ (0.0000001,-210) [-210|211.1081215] "deg" Vector__XXX

BO_ 2566845182 LFE1: 8 Vector__XXX
 SG_ EngineFuelRate : 0|16@1+ (0.05,0) [0|3212.75] "l/h" Vector__XXX

BO_ 2364541694 EGF1: 8 Vector__XXX
 SG_ EngineIntakeAirMassFlowRate : 16|16@1+ (0.05,0) [0|3212.75] "kg/h" Vector__XXX

BO_ 2566846718 TRF1: 8 Vector__XXX
 SG_ TransmissionOilTemperature1 : 32|16@1+ (0.03125,-273) [-273|1734.96875] "degC" Vector__XXX

CM_ BO_ 2365523200 "Short test message";
CM_ BO_ 2365522944 "Long test message";

CM_ BO_ 2364540158 "Electronic Engine Controller 1";
CM_ SG_ 2364540158 EngineSpeed "Actual engine speed which is calculated over a minimum crankshaft angle of 720 degrees divided by the number of cylinders.…";
CM_ BO_ 2566844926 "Cruise Control/Vehicle Speed 1";
CM_ SG_ 2566844926 WheelBasedVehicleSpeed "Wheel-Based Vehicle Speed: Speed of the vehicle as calculated from wheel or tailshaft speed.";
CM_ BO_ 2566845438 "Vehicle Position 1";
CM_ SG_ 2566845438 Latitude "Latitude: Latitude position of the vehicle.Negative values are South and positive values are North.";
CM_ SG_ 2566845438 Longitude "Longitude: Longitude position of the vehicle.Negative values are West and positive value are East.";
CM_ BO_ 2566845182 "Fuel Economy (Liquid)";
CM_ SG_ 2566845182 EngineFuelRate "Engine Fuel Rate: Amount of fuel consumed by engine per unit of time.NOTE - See SPN 1600 for alternate resolution.";
CM_ BO_ 2364541694 "Engine Gas Flow Rate";
CM_ SG_ 2364541694 EngineIntakeAirMassFlowRate "Engine Intake Air Mass Flow Rate: Mass flow rate of fresh air entering the engine air intake, before any EGR mixer, if used.  Flow rate of fresh air conducted to the engine cylinders to support combustion.";
CM_ BO_ 2566846718 "Transmission Fluids 1";
CM_ SG_ 2566846718 TransmissionOilTemperature1 "Transmission Oil Temperature 1: First instance of transmission lubricant temperature.";
BA_DEF_ SG_  "SPN" INT 0 524287;
BA_DEF_ BO_  "VFrameFormat" ENUM  "StandardCAN","ExtendedCAN","reserved","J1939PG";
BA_DEF_  "DatabaseVersion" STRING ;
BA_DEF_  "BusType" STRING ;
BA_DEF_  "ProtocolType" STRING ;
BA_DEF_  "DatabaseCompiler" STRING ;
BA_DEF_DEF_  "SPN" 0;
BA_DEF_DEF_  "VFrameFormat" "J1939PG";
BA_DEF_DEF_  "DatabaseVersion" "DEMO PLUS";
BA_DEF_DEF_  "BusType" "";
BA_DEF_DEF_  "ProtocolType" "";
BA_DEF_DEF_  "DatabaseCompiler" "";
BA_ "ProtocolType" "J1939";
BA_ "BusType" "CAN";
BA_ "DatabaseCompiler" "CSS ELECTRONICS (WWW.CSSELECTRONICS.COM)";
BA_ "DatabaseVersion" "1.0.0";
BA_ "SPN" SG_ 2364540158 EngineSpeed 190;
BA_ "SPN" SG_ 2566844926 WheelBasedVehicleSpeed 84;
BA_ "SPN" SG_ 2566845438 Latitude 584;
BA_ "SPN" SG_ 2566845438 Longitude 585;
BA_ "SPN" SG_ 2566845182 EngineFuelRate 183;
BA_ "SPN" SG_ 2364541694 EngineIntakeAirMassFlowRate 132;
BA_ "SPN" SG_ 2566846718 TransmissionOilTemperature1 177;
